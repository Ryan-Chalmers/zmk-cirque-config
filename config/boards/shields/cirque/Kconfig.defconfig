## config/boards/shields/cirque/Kconfig.defconfig
```kconfig
if SHIELD_CIRQUE_LEFT

config ZMK_KEYBOARD_NAME
    default "Cirque"

config ZMK_SPLIT_ROLE_CENTRAL
    default y

endif

if SHIELD_CIRQUE_LEFT || SHIELD_CIRQUE_RIGHT

config ZMK_SPLIT
    default y

endif
```

## config/boards/shields/cirque/Kconfig.shield
```kconfig
config SHIELD_CIRQUE_LEFT
    def_bool $(shields_list_contains,cirque_left)

config SHIELD_CIRQUE_RIGHT
    def_bool $(shields_list_contains,cirque_right)
```
